#pragma once
// BBSSurvival — Emergency survival guide on external flash
//
// Reads /bbs/kb/survival.bin from external QSPI flash.
// Generated by gen_survival_packed.py
//
// Binary format:
//   magic       uint32  0x53555256 ("SURV")
//   cat_count   uint16  number of categories
//   tip_count   uint16  total number of tips
//   index[cat_count]:
//     name        char[16]  category name (null-terminated)
//     first_tip   uint16    index of first tip in this category
//     num_tips    uint16    number of tips in this category
//   tips[tip_count]:
//     len         uint8     length of tip text
//     text        char[len] tip text (NOT null-terminated in file)

#if defined(NRF52_SERIES) && !defined(BBS_LITE)

#include "BBSExtFlash.h"
#include <cstring>

#define KB_SURVIVAL_PATH  "/bbs/kb/survival.bin"
#define KB_SURVIVAL_MAGIC 0x53555256

struct SurvivalCatEntry {
    char     name[16];
    uint16_t firstTip;
    uint16_t numTips;
};

// Get a random tip from the survival database
static bool survivalGetRandom(uint32_t seed, char *buf, size_t bufLen) {
    if (!buf || bufLen == 0) return false;
    buf[0] = '\0';

    File f = bbsExtFS().open(KB_SURVIVAL_PATH, FILE_O_READ);
    if (!f) return false;

    uint32_t magic = 0;
    uint16_t catCount = 0, tipCount = 0;
    f.read((uint8_t *)&magic, 4);
    f.read((uint8_t *)&catCount, 2);
    f.read((uint8_t *)&tipCount, 2);
    if (magic != KB_SURVIVAL_MAGIC || tipCount == 0) { f.close(); return false; }

    // Skip index to find tip offsets
    uint32_t indexSize = catCount * 20; // 16 + 2 + 2 per category
    uint32_t tipsStart = 8 + indexSize;

    // Seek to random tip
    uint16_t target = seed % tipCount;
    f.seek(tipsStart);
    for (uint16_t i = 0; i < target; i++) {
        uint8_t len = 0;
        f.read(&len, 1);
        f.seek(f.position() + len);
    }

    // Read the tip
    uint8_t len = 0;
    f.read(&len, 1);
    if (len >= bufLen) len = bufLen - 1;
    f.read((uint8_t *)buf, len);
    buf[len] = '\0';
    f.close();
    return true;
}

// Get category count
static uint16_t survivalCategoryCount() {
    File f = bbsExtFS().open(KB_SURVIVAL_PATH, FILE_O_READ);
    if (!f) return 0;
    uint32_t magic = 0;
    uint16_t catCount = 0;
    f.read((uint8_t *)&magic, 4);
    f.read((uint8_t *)&catCount, 2);
    f.close();
    if (magic != KB_SURVIVAL_MAGIC) return 0;
    return catCount;
}

// Get category name by index
static bool survivalCategoryName(uint16_t catIdx, char *name, size_t nameLen) {
    File f = bbsExtFS().open(KB_SURVIVAL_PATH, FILE_O_READ);
    if (!f) return false;
    uint32_t magic = 0;
    uint16_t catCount = 0;
    f.read((uint8_t *)&magic, 4);
    f.read((uint8_t *)&catCount, 2);
    f.seek(6); // skip tipCount
    if (magic != KB_SURVIVAL_MAGIC || catIdx >= catCount) { f.close(); return false; }
    f.seek(8 + catIdx * 20);
    char catName[16];
    f.read((uint8_t *)catName, 16);
    f.close();
    strncpy(name, catName, nameLen - 1);
    name[nameLen - 1] = '\0';
    return true;
}

// Get a tip from a specific category
static bool survivalGetTip(uint16_t catIdx, uint16_t tipIdx, char *buf, size_t bufLen) {
    if (!buf || bufLen == 0) return false;
    buf[0] = '\0';

    File f = bbsExtFS().open(KB_SURVIVAL_PATH, FILE_O_READ);
    if (!f) return false;

    uint32_t magic = 0;
    uint16_t catCount = 0, tipCount = 0;
    f.read((uint8_t *)&magic, 4);
    f.read((uint8_t *)&catCount, 2);
    f.read((uint8_t *)&tipCount, 2);
    if (magic != KB_SURVIVAL_MAGIC || catIdx >= catCount) { f.close(); return false; }

    // Read category entry
    f.seek(8 + catIdx * 20);
    SurvivalCatEntry cat;
    f.read((uint8_t *)&cat, 20);
    if (tipIdx >= cat.numTips) { f.close(); return false; }

    // Seek to the tip
    uint32_t indexSize = catCount * 20;
    uint32_t tipsStart = 8 + indexSize;
    uint16_t globalTip = cat.firstTip + tipIdx;

    f.seek(tipsStart);
    for (uint16_t i = 0; i < globalTip; i++) {
        uint8_t len = 0;
        f.read(&len, 1);
        f.seek(f.position() + len);
    }

    uint8_t len = 0;
    f.read(&len, 1);
    if (len >= bufLen) len = bufLen - 1;
    f.read((uint8_t *)buf, len);
    buf[len] = '\0';
    f.close();
    return true;
}

#endif // NRF52_SERIES && !BBS_LITE
