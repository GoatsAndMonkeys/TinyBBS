#pragma once
// BBSTinyScreen — Minimal SSD1306 OLED text driver for BBS status display
//
// ~3KB flash instead of ~150KB for the full Meshtastic Screen framework.
// Drives the SSD1306 (128x64 or 128x32) via I2C using a built-in 5x7 font.
// No dependencies on OLEDDisplay, GFX libraries, or Meshtastic's Screen class.
//
// Usage:
//   BBSTinyScreen screen;
//   screen.begin();        // auto-detects 0x3C or 0x3D
//   screen.clear();
//   screen.printAt(0, 0, "TinyBBS");
//   screen.display();      // flush to OLED
//
// For boards with MESHTASTIC_EXCLUDE_SCREEN=1 that still want a status display.

#ifdef NRF52_SERIES

#include <Wire.h>
#include <cstring>
#include <cstdio>

// SSD1306 I2C addresses (try 0x3C first, then 0x3D)
#define SSD1306_ADDR_A  0x3C
#define SSD1306_ADDR_B  0x3D

// Display dimensions
#define TSCR_WIDTH   128
#define TSCR_HEIGHT  64
#define TSCR_PAGES   (TSCR_HEIGHT / 8)   // 8 pages of 8 pixels each
#define TSCR_BUFSIZE (TSCR_WIDTH * TSCR_PAGES)  // 1024 bytes

// Font: 5x7 pixel, ASCII 32-126 (95 characters)
// Each character is 5 bytes (columns), MSB=bottom pixel of each column
// Stored in flash (PROGMEM equivalent for nRF52 is just const)
static const uint8_t TSCR_FONT_5X7[][5] = {
    {0x00,0x00,0x00,0x00,0x00}, // 32 space
    {0x00,0x00,0x5F,0x00,0x00}, // 33 !
    {0x00,0x07,0x00,0x07,0x00}, // 34 "
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    {0x08,0x08,0x2A,0x1C,0x08}, // 126 ~
};

class BBSTinyScreen {
  private:
    uint8_t buf_[TSCR_BUFSIZE];
    uint8_t addr_ = 0;
    bool    found_ = false;

    void cmd(uint8_t c) {
        Wire.beginTransmission(addr_);
        Wire.write(0x00);  // command mode
        Wire.write(c);
        Wire.endTransmission();
    }

    void initDisplay() {
        static const uint8_t init_cmds[] = {
            0xAE,       // display off
            0xD5, 0x80, // clock divider
            0xA8, 0x3F, // multiplex 64
            0xD3, 0x00, // display offset 0
            0x40,       // start line 0
            0x8D, 0x14, // charge pump on
            0x20, 0x00, // horizontal addressing
            0xA1,       // segment remap
            0xC8,       // COM scan decrement
            0xDA, 0x12, // COM pins
            0x81, 0xCF, // contrast
            0xD9, 0xF1, // precharge
            0xDB, 0x40, // VCOMH deselect
            0xA4,       // display from RAM
            0xA6,       // normal (not inverted)
            0xAF,       // display on
        };
        for (size_t i = 0; i < sizeof(init_cmds); i++) {
            cmd(init_cmds[i]);
        }
    }

  public:
    bool begin() {
        Wire.begin();

        // Probe for SSD1306 at 0x3C then 0x3D
        for (uint8_t a : {SSD1306_ADDR_A, SSD1306_ADDR_B}) {
            Wire.beginTransmission(a);
            if (Wire.endTransmission() == 0) {
                addr_ = a;
                found_ = true;
                break;
            }
        }
        if (!found_) return false;

        initDisplay();
        clear();
        display();
        return true;
    }

    bool found() const { return found_; }

    void clear() {
        memset(buf_, 0, sizeof(buf_));
    }

    // Draw a single character at pixel position (x, page)
    // page = 0-7 (each page is 8 pixels tall)
    void drawChar(uint8_t x, uint8_t page, char c) {
        if (c < 32 || c > 126) c = '?';
        const uint8_t *glyph = TSCR_FONT_5X7[c - 32];
        uint16_t base = page * TSCR_WIDTH + x;
        for (uint8_t col = 0; col < 5 && (x + col) < TSCR_WIDTH; col++) {
            buf_[base + col] = glyph[col];
        }
        // 1 pixel gap between characters
        if (x + 5 < TSCR_WIDTH) buf_[base + 5] = 0x00;
    }

    // Print string at character grid position (col, row)
    // Each char is 6px wide (5+1 gap), 8px tall (1 page)
    // 128/6 = 21 chars per line, 64/8 = 8 lines
    void printAt(uint8_t col, uint8_t row, const char *str) {
        uint8_t x = col * 6;
        for (; *str && x < TSCR_WIDTH; str++, x += 6) {
            drawChar(x, row, *str);
        }
    }

    // Print with printf formatting
    void printfAt(uint8_t col, uint8_t row, const char *fmt, ...) __attribute__((format(printf, 4, 5))) {
        char tmp[22]; // 21 chars + null
        va_list ap;
        va_start(ap, fmt);
        vsnprintf(tmp, sizeof(tmp), fmt, ap);
        va_end(ap);
        printAt(col, row, tmp);
    }

    // Draw a horizontal line at pixel row y (within page)
    void hline(uint8_t y) {
        uint8_t page = y / 8;
        uint8_t bit  = y % 8;
        uint16_t base = page * TSCR_WIDTH;
        for (uint8_t x = 0; x < TSCR_WIDTH; x++) {
            buf_[base + x] |= (1 << bit);
        }
    }

    // Invert a row (white background, black text)
    void invertRow(uint8_t row) {
        uint16_t base = row * TSCR_WIDTH;
        for (uint8_t x = 0; x < TSCR_WIDTH; x++) {
            buf_[base + x] ^= 0xFF;
        }
    }

    // Flush framebuffer to OLED
    void display() {
        if (!found_) return;

        // Set column and page address to cover full screen
        cmd(0x21); cmd(0); cmd(TSCR_WIDTH - 1);   // column range
        cmd(0x22); cmd(0); cmd(TSCR_PAGES - 1);    // page range

        // Send framebuffer in 16-byte chunks (Wire buffer limit)
        for (uint16_t i = 0; i < TSCR_BUFSIZE; i += 16) {
            Wire.beginTransmission(addr_);
            Wire.write(0x40); // data mode
            uint16_t end = i + 16;
            if (end > TSCR_BUFSIZE) end = TSCR_BUFSIZE;
            for (uint16_t j = i; j < end; j++) {
                Wire.write(buf_[j]);
            }
            Wire.endTransmission();
        }
    }
};

#endif // NRF52_SERIES
